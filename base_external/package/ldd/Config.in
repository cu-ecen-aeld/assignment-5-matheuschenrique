## base_external/package/ldd/Config.in
```kconfig
config BR2_PACKAGE_LDD
    bool "ldd"
    depends on BR2_LINUX_KERNEL
    help
	  Adds device drivers from misc-modules and scull in the filesystem
```
